#include "charybdis.dtsi"
#include "charybdis_pmw3610.dtsi"

&kscan0 {
	compatible = "zmk,kscan-gpio-matrix";
	
	col-gpios
		= <&pro_micro 19 (GPIO_ACTIVE_HIGH | GPIO_PULL_DOWN)>
		, <&pro_micro 20 (GPIO_ACTIVE_HIGH | GPIO_PULL_DOWN)>
		, <&pro_micro 10 (GPIO_ACTIVE_HIGH | GPIO_PULL_DOWN)>
		, <&pro_micro 6 (GPIO_ACTIVE_HIGH | GPIO_PULL_DOWN)>
		, <&pro_micro 7 (GPIO_ACTIVE_HIGH | GPIO_PULL_DOWN)>
		, <&pro_micro 8 (GPIO_ACTIVE_HIGH | GPIO_PULL_DOWN)>
		;

	row-gpios
		= <&pro_micro 18 GPIO_ACTIVE_HIGH>
		, <&pro_micro 5 GPIO_ACTIVE_HIGH>
		, <&pro_micro 4 GPIO_ACTIVE_HIGH>
		, <&pro_micro 9 GPIO_ACTIVE_HIGH>
		;
};



/ {
    // Defines the Input Processor node for X/Y movement scaling
    zip_xy_scaler: zip_xy_scaler {
 #input-processor-cells = <2>;
        compatible = "zmk,input-processor-xy-scaler";
        #binding-cells = <2>;
    };

    // Defines the Input Processor node for scroll wheel scaling
    zip_wheel_scaler: zip_wheel_scaler {
        compatible = "zmk,input-processor-wheel-scaler";
        #binding-cells = <2>;
    };
};

