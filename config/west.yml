## config/west.yml
```yaml
manifest:
  remotes:
    - name: zmkfirmware
      url-base: https://github.com/zmkfirmware
    - name: badjeff # KEEP this remote for now, but remove its projects below
      url-base: https://github.com/badjeff
  projects:
    - name: zmk
      remote: zmkfirmware
      revision: main
      import: app/west.yml
    
    # --- DEPRECATED PROJECTS REMOVED ---
    # - name: zmk-pmw3610-driver
    #   remote: badjeff
    #   revision: main
    # - name: zmk-split-peripheral-input-relay
    #   remote: badjeff
    #   revision: main
    # -----------------------------------
  
  self:
    path: config
```
